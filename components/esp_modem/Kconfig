## components/esp_modem/Kconfig
```kconfig
menu "ESP-MODEM"

    config ESP_MODEM_PPP_ENABLE
        bool "Modem support ppp"
        default n
        help
            Esp modem enable ppp.

    config ESP_MODEM_COMPONENT_APN
        string "Set Access Point Name (APN)"
        default "CMNET"
        depends on ESP_MODEM_PPP_ENABLE
        help
            Logical name which is used to select the GGSN or the external packet data network.

endmenu
```

## demo/hello_world/main/Kconfig.projbuild
```kconfig
menu "app Configuration"

    config APP_UART_ISR_IN_RAM
        bool "Modem Use UART ISR in RAM"
        default n
        select UART_ISR_IN_IRAM
        help
            Enable placing UART ISR to IRAM.
            This options is useful if PPPoS client needs to perform
            flash operations (e.g. OTA) while keeping the network operational.
            
    config APP_ENABLE_LCP_ECHO
        bool "Enable LCP ECHO"
        default n
        select LWIP_ENABLE_LCP_ECHO
        help
            Enable this option to make use of LCP keepalive using
            LCP_ECHO_INTERVAL and LCP_MAXECHOFAILS to default values

    menu "Modem Configuration"
	    choice MODEM_DEVICE
	        prompt "Choose supported modem device (DCE)"
	        default MODEM_DEVICE_BG95
	        help
	            Select modem device connected to the ESP DTE.
	        config MODEM_DEVICE_SIM800
	            bool "SIM800"
	            help
	                SIMCom SIM800L is a GSM/GPRS module.
	                It supports Quad-band 850/900/1800/1900MHz.
	        config MODEM_DEVICE_BG96
	            bool "BG96"
	            help
	                Quectel BG96 is a series of LTE Cat M1/Cat NB1/EGPRS module.
	        config MODEM_DEVICE_BG95
	            bool "BG95"
	            help
	                Quectel BG95 is a series of LTE Cat M1/Cat NB1/EGPRS module.  
	        config MODEM_DEVICE_SIM7600
	            bool "SIM7600"
	            help
	                SIM7600 is Multi-Band LTE-TDD/LTE-FDD/HSPA+ and GSM/GPRS/EDGE module
	    endchoice

	    config MODEM_PPP_AUTH_USERNAME
	        string "Set username for authentication"
	        default "espressif"
	        depends on ESP_MODEM_PPP_ENABLE
	        depends on !MODEM_PPP_AUTH_NONE
	        help
	            Set username for PPP Authentication.

	    config MODEM_PPP_AUTH_PASSWORD
	        string "Set password for authentication"
	        default "esp32"
	        depends on ESP_MODEM_PPP_ENABLE
	        depends on !MODEM_PPP_AUTH_NONE
	        help
	            Set password for PPP Authentication.

	    config MODEM_PPP_AUTH_NONE
	        bool "Skip PPP authentication"
	        default y
	        depends on ESP_MODEM_PPP_ENABLE
	        help
	            Set to true for the PPP client to skip authentication

	   	config MODEM_POWER_PIN
            int "POWER Pin Number"
            default 12
            range 0 31
            help
                Pin number of Modem POWER.
                
    	config MODEM_RESET_PIN
            int "RESET Pin Number"
            default 13
            range 0 31
            help
                Pin number of Modem RESET.

    	config MODEM_LED_INDICATOR_PIN
            int "LED INDICATOR Pin Number"
            default 0
            range 0 31
            help
                Pin number of Modem Led Indicator.
                
	    config MODEM_UART_TX_PIN
            int "TXD Pin Number"
            default 17
            range 0 31
            help
                Pin number of UART TX.

        config MODEM_UART_TX_PIN
            int "TXD Pin Number"
            default 17
            range 0 31
            help
                Pin number of UART TX.

        config MODEM_UART_RX_PIN
            int "RXD Pin Number"
            default 18
            range 0 31
            help
                Pin number of UART RX.

        config MODEM_UART_RTS_PIN
            int "RTS Pin Number"
            default 0
            range 0 31
            help
                Pin number of UART RTS.

        config MODEM_UART_CTS_PIN
            int "CTS Pin Number"
            default 0
            range 0 31
            help
                Pin number of UART CTS.

        config MODEM_UART_EVENT_TASK_STACK_SIZE
            int "UART Event Task Stack Size"
            range 2000 6000
            default 4096
            help
                Stack size of UART event task.

        config MODEM_UART_EVENT_TASK_PRIORITY
            int "UART Event Task Priority"
            range 3 22
            default 5
            help
                Priority of UART event task.

        config MODEM_UART_EVENT_QUEUE_SIZE
            int "UART Event Queue Size"
            range 10 40
            default 30
            help
                Length of UART event queue.

        config MODEM_UART_TX_BUFFER_SIZE
            int "UART TX Buffer Size"
            range 256 2048
            default 512
            help
                Buffer size of UART TX buffer.

        config MODEM_UART_RX_BUFFER_SIZE
            int "UART RX Buffer Size"
            range 256 2048
            default 1024
            help
                Buffer size of UART RX buffer.
    endmenu

    menu "wifi Configuration"
	    config WIFI_DEFAULT_SSID
	        string "WiFi SSID"
	        default "myssid"
	        help
	            SSID (network name) for connect to.

	    config WIFI_DEFAULT_PASSWORD
	        string "WiFi Password"
	        default "mypassword"
	        help
	            WiFi password (WPA or WPA2) for use.

	    config WIFI_DEFAULT_LISTEN_INTERVAL
	        int "WiFi listen interval"
	        default 3
	        help
	            Interval for station to listen to beacon from AP. The unit of listen interval is one beacon interval.
	            For example, if beacon interval is 100 ms and listen interval is 3, the interval for station to listen
	            to beacon is 300 ms.
	 	choice WIFI_POWER_SAVE_MODE
	        prompt "wifi power save mode"
	        default WIFI_POWER_SAVE_MIN_MODEM
	        help
	            Power save mode for the esp32 to use. Modem sleep mode includes minimum and maximum power save modes.
	            In minimum power save mode, station wakes up every DTIM to receive beacon. Broadcast data will not be
	            lost because it is transmitted after DTIM. However, it can not save much more power if DTIM is short
	            for DTIM is determined by AP.
	            In maximum power save mode, station wakes up every listen interval to receive beacon. Broadcast data
	            may be lost because station may be in sleep state at DTIM time. If listen interval is longer, more power
	            is saved but broadcast data is more easy to lose.
	        config WIFI_POWER_SAVE_NONE
	            bool "none"
	        config WIFI_POWER_SAVE_MIN_MODEM
	            bool "minimum modem"
	        config WIFI_POWER_SAVE_MAX_MODEM
	            bool "maximum modem"
	    endchoice
    endmenu

    menu "Power Manager Configuration"
	    choice PM_MAX_CPU_FREQ
	        prompt "Maximum CPU frequency"
	        default PM_MAX_CPU_FREQ_160
	        depends on PM_ENABLE
	        help
	            Maximum CPU frequency to use for dynamic frequency scaling.

	        config PM_MAX_CPU_FREQ_80
	            bool "80 MHz"
	        config PM_MAX_CPU_FREQ_160
	            bool "160 MHz"
	        config PM_MAX_CPU_FREQ_240
	            bool "240 MHz"
	            depends on IDF_TARGET_ESP32 || IDF_TARGET_ESP32S2 || IDF_TARGET_ESP32S3
	    endchoice

	    config PM_MAX_CPU_FREQ_MHZ
	        int
	        default 80 if PM_MAX_CPU_FREQ_80
	        default 160 if PM_MAX_CPU_FREQ_160
	        default 240 if PM_MAX_CPU_FREQ_240


	    choice PM_MIN_CPU_FREQ
	        prompt "Minimum CPU frequency"
	        default PM_MIN_CPU_FREQ_10M
	        depends on PM_ENABLE
	        help
	            Minimum CPU frequency to use for dynamic frequency scaling.
	            Should be set to XTAL frequency or XTAL frequency divided by integer.

	        config PM_MIN_CPU_FREQ_40M
	            bool "40 MHz (use with 40MHz XTAL)"
	            depends on !IDF_TARGET_ESP32 || ESP32_XTAL_FREQ_40 || ESP32_XTAL_FREQ_AUTO
	        config PM_MIN_CPU_FREQ_20M
	            bool "20 MHz (use with 40MHz XTAL)"
	            depends on !IDF_TARGET_ESP32 || ESP32_XTAL_FREQ_40 || ESP32_XTAL_FREQ_AUTO
	        config PM_MIN_CPU_FREQ_10M
	            bool "10 MHz (use with 40MHz XTAL)"
	            depends on !IDF_TARGET_ESP32 || ESP32_XTAL_FREQ_40 || ESP32_XTAL_FREQ_AUTO
	        config PM_MIN_CPU_FREQ_26M
	            bool "26 MHz (use with 26MHz XTAL)"
	            depends on ESP32_XTAL_FREQ_26 || ESP32_XTAL_FREQ_AUTO
	        config PM_MIN_CPU_FREQ_13M
	            bool "13 MHz (use with 26MHz XTAL)"
	            depends on ESP32_XTAL_FREQ_26 || ESP32_XTAL_FREQ_AUTO
	    endchoice

	    config PM_MIN_CPU_FREQ_MHZ
	        int
	        default 40 if PM_MIN_CPU_FREQ_40M
	        default 20 if PM_MIN_CPU_FREQ_20M
	        default 10 if PM_MIN_CPU_FREQ_10M
	        default 26 if PM_MIN_CPU_FREQ_26M
	        default 13 if PM_MIN_CPU_FREQ_13M
    endmenu
endmenu
```
